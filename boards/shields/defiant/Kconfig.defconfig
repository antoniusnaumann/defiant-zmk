## boards/shields/defiant/Kconfig.defconfig
```kconfig
if DEFIANT_RIGHT

config ZMK_KEYBOARD_NAME
    default "Defiant"

config ZMK_SPLIT_ROLE_CENTRAL
    default y

endif

if DEFIANT_LEFT || DEFIANT_RIGHT

config ZMK_SPLIT
    default y

endif
```

## boards/shields/defiant/Kconfig.shield
```kconfig
config DEFIANT_LEFT
    def_bool $(shields_list_contains,defiant_left)

config DEFIANT_RIGHT
    def_bool $(shields_list_contains,defiant_right)
```
